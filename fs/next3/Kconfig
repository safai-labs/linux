## fs/next3/Kconfig
```kconfig
config NEXT3_FS
	tristate "Next3 journalling file system support"
	select JBD
	help
	  This is the journalling version of the Second extended file system
	  (often called next3), the de facto standard Linux file system
	  (method to organize files on a storage device) for hard disks.

	  The journalling code included in this driver means you do not have
	  to run e2fsck (file system checker) on your file systems after a
	  crash.  The journal keeps track of any changes that were being made
	  at the time the system crashed, and can ensure that your file system
	  is consistent without the need for a lengthy check.

	  Other than adding the journal to the file system, the on-disk format
	  of next3 is identical to ext2.  It is possible to freely switch
	  between using the next3 driver and the ext2 driver, as long as the
	  file system has been cleanly unmounted, or e2fsck is run on the file
	  system.

	  To add a journal on an existing ext2 file system or change the
	  behavior of next3 file systems, you can use the tune2fs utility ("man
	  tune2fs").  To modify attributes of files and directories on next3
	  file systems, use chattr ("man chattr").  You need to be using
	  e2fsprogs version 1.20 or later in order to create next3 journals
	  (available at <http://sourceforge.net/projects/e2fsprogs/>).

	  To compile this file system support as a module, choose M here: the
	  module will be called next3.

config NEXT3_DEFAULTS_TO_ORDERED
	bool "Default to 'data=ordered' in next3"
	depends on NEXT3_FS
	help
	  The journal mode options for next3 have different tradeoffs
	  between when data is guaranteed to be on disk and
	  performance.	The use of "data=writeback" can cause
	  unwritten data to appear in files after an system crash or
	  power failure, which can be a security issue.	 However,
	  "data=ordered" mode can also result in major performance
	  problems, including seconds-long delays before an fsync()
	  call returns.	 For details, see:

	  http://ext4.wiki.kernel.org/index.php/Next3_data_mode_tradeoffs

	  If you have been historically happy with next3's performance,
	  data=ordered mode will be a safe choice and you should
	  answer 'y' here.  If you understand the reliability and data
	  privacy issues of data=writeback and are willing to make
	  that trade off, answer 'n'.

config NEXT3_FS_XATTR
	bool "Next3 extended attributes"
	depends on NEXT3_FS
	default y
	help
	  Extended attributes are name:value pairs associated with inodes by
	  the kernel or by users (see the attr(5) manual page, or visit
	  <http://acl.bestbits.at/> for details).

	  If unsure, say N.

	  You need this for POSIX ACL support on next3.

config NEXT3_FS_POSIX_ACL
	bool "Next3 POSIX Access Control Lists"
	depends on NEXT3_FS_XATTR
	select FS_POSIX_ACL
	help
	  Posix Access Control Lists (ACLs) support permissions for users and
	  groups beyond the owner/group/world scheme.

	  To learn more about Access Control Lists, visit the Posix ACLs for
	  Linux website <http://acl.bestbits.at/>.

	  If you don't know what Access Control Lists are, say N

config NEXT3_FS_SECURITY
	bool "Next3 Security Labels"
	depends on NEXT3_FS_XATTR
	help
	  Security labels support alternative access control models
	  implemented by security modules like SELinux.  This option
	  enables an extended attribute handler for file security
	  labels in the next3 filesystem.

	  If you are not using a security module that requires using
	  extended attributes for file security labels, say N.

config NEXT3_FS_SNAPSHOT
	bool "Next3 snapshot support"
	depends on NEXT3_FS
	default y
	help
	  If you say N here, then Next3 will be identical to Ext3.

config NEXT3_FS_DEBUG
	bool "Next3 snapshot debugging support"
	depends on NEXT3_FS
	select DEBUG_FS
	default y
	help
	  Control snapshot debug level via debugfs entry /next3/snapshot-debug.
	  Control snapshot unit tests via debugfs entries /next3/test-XXX.

config NEXT3_FS_SNAPSHOT_HOOKS
	bool "Next3 snapshot hooks"
	depends on NEXT3_FS_SNAPSHOT
	default y
	help
	  Insert generic snapshot API calls inside Next3 file system.

config NEXT3_FS_SNAPSHOT_HOOKS_JBD
	bool "Next3 snapshot hooks - inside JBD hooks"
	depends on NEXT3_FS_SNAPSHOT_HOOKS
	default y
	help
	  Before every meta data buffer write, the journal API is called,
	  namely, one of the next3_journal_get_XXX_access() functions.
	  we use these journal hooks to call the snapshot API,
	  before every meta data buffer write.

config NEXT3_FS_SNAPSHOT_HOOKS_DELETE
	bool "Next3 snapshot hooks - delete blocks"
	depends on NEXT3_FS_SNAPSHOT_HOOKS
	default y
	help
	  Before deleting file blocks in next3_free_blocks(),
	  we call the snapshot API snapshot_get_delete_access(),
	  to optionally move the block to the snapshot file.

config NEXT3_FS_SNAPSHOT_HOOKS_DATA
	bool "Next3 snapshot hooks - move data blocks"
	depends on NEXT3_FS_SNAPSHOT_HOOKS
	default y
	help
	  Before every regular file data buffer write,
	  the function next3_get_block() is called to map the buffer to disk.
	  we use this hook to call the snapshot API snapshot_get_move_access(),
	  to optionally move the block to the snapshot file.

config NEXT3_FS_SNAPSHOT_FILE
	bool "Next3 snapshot file"
	depends on NEXT3_FS_SNAPSHOT
	default y
	help
	  Next3 snapshot implementation as a file inside the file system.
	  Snapshot files are marked with the snapfile flag and have special
	  read-only aops.

config NEXT3_FS_SNAPSHOT_FILE_PEEP
	bool "Next3 snapshot file - read through to block device"
	depends on NEXT3_FS_SNAPSHOT_FILE
	default y
	help
	  On active snapshot file page read, the function next3_get_block()
	  is called to map the page to a disk block.  If the page is not mapped
	  in the snapshot file a direct mapping to the block device is returned.

config NEXT3_FS_SNAPSHOT_FILE_PERM
	bool "Next3 snapshot file - permissions"
	depends on NEXT3_FS_SNAPSHOT_FILE
	default y
	help
	  Enforce snapshot file permissions.
	  Write truncate and unlink of snapshot inodes is not allowed.

config NEXT3_FS_SNAPSHOT_FILE_STORE
	bool "Next3 snapshot file - store on disk"
	depends on NEXT3_FS_SNAPSHOT_FILE
	default y
	help
	  Snapshot inode is stored differently in memory and on disk.
	  During store and load of snapshot inode, some of the inode flags
	  and fields are converted.

config NEXT3_FS_SNAPSHOT_BLOCK
	bool "Next3 snapshot block operations"
	depends on NEXT3_FS_SNAPSHOT_FILE
	default y
	help
	  Core implementation of special snapshot file block operations.
	  The argument @create to the function next3_get_blocks_handle()
	  is re-interpreted as a snapshot block command argument.  The old
	  argument values 0(=read) and 1(=create) preserve the original
	  behavior of the function.  The bit field h_cowing in the current
	  transaction handle is used to prevent COW recursions.

config NEXT3_FS_SNAPSHOT_BLOCK_COW
	bool "Next3 snapshot block operation - copy blocks to snapshot"
	depends on NEXT3_FS_SNAPSHOT_BLOCK
	default y
	help
	  Imeplementation of copying blocks into a snapshot file.
	  This mechanism is used to copy-on-write metadata blocks to snapshot.

config NEXT3_FS_SNAPSHOT_BLOCK_BITMAP
	bool "Next3 snapshot block operation - copy block bitmap to snapshot"
	depends on NEXT3_FS_SNAPSHOT_BLOCK
	default y
	help
	  The snapshot copy of the file system block bitmap is called the COW
	  bitmap and it is used to check if a block was allocated at the time
	  that the snapshot was taken.

config NEXT3_FS_SNAPSHOT_BLOCK_MOVE
	bool "Next3 snapshot block operation - move blocks to snapshot"
	depends on NEXT3_FS_SNAPSHOT_BLOCK
	default y
	help
	  Imeplementation of moving blocks into a snapshot file.
	  The move block command maps an allocated blocks to the snapshot file,
	  allocating only the indirect blocks when needed.
	  This mechanism is used to move-on-write data blocks to snapshot.

config NEXT3_FS_SNAPSHOT_BLOCK_GOAL
	bool "Next3 snapshot block operation - allocation goal"
	depends on NEXT3_FS_SNAPSHOT_BLOCK
	default n
	help
	  Allocate snapshot COWed blocks close to their source block.
	  This may be good for snapshot read performance, but might cause
	  higher defragmentation levels in data files.

config NEXT3_FS_SNAPSHOT_CTL
	bool "Next3 snapshot control"
	depends on NEXT3_FS_SNAPSHOT_FILE
	default y
	help
	  Snapshot control with chattr -X.
	  Take/delete snapshot with chattr -X +/-S.
	  Enable/disable snapshot with chattr -X +/-n.

config NEXT3_FS_SNAPSHOT_CTL_INIT
	bool "Next3 snapshot control - init new snapshot"
	depends on NEXT3_FS_SNAPSHOT_CTL
	default y
	help
	  On snapshot create, a few special blocks (i.e. the super block and
	  group descriptors) are pre-allocated and on snapshot take, they are
	  copied under journal_lock_updates().  This is done to avoid the
	  recursion that would be caused by COWing these blocks after the
	  snapshot becomes active.

config NEXT3_FS_SNAPSHOT_CTL_FIX
	bool "Next3 snapshot control - fix new snapshot"
	depends on NEXT3_FS_SNAPSHOT_CTL_INIT
	default y
	help
	  On snapshot take, after copying the pre-allocated blocks, some are
	  fixed to make the snapshot image appear as a valid Ext2 file system.

config NEXT3_FS_SNAPSHOT_CTL_RESERVE
	bool "Next3 snapshot control - reserve disk space for snapshot"
	depends on NEXT3_FS_SNAPSHOT_CTL
	default y
	help
	  Ensure there is enough disk space for snapshot file future use.
	  Reserve disk space on snapshot take based on file system overhead
	  size, number of directories and number of blocks/inodes in use.

config NEXT3_FS_SNAPSHOT_CTL_DUMP
	bool "Next3 snapshot control - dump snapshot file blocks map"
	depends on NEXT3_FS_SNAPSHOT_FILE
	depends on NEXT3_FS_DEBUG
	default y
	help
	  Use chattr -d to print the blocks map of a snapshot file.
	  Snapshot debugging should be enabled.

config NEXT3_FS_SNAPSHOT_JOURNAL
	bool "Next3 snapshot journaled"
	depends on NEXT3_FS_SNAPSHOT_BLOCK
	default y
	help
	  Next3 snapshot operations are journaled inside the same transaction
	  with the file system operation that triggered them.

config NEXT3_FS_SNAPSHOT_JOURNAL_ERROR
	bool "Next3 snapshot journaled - record journal error"
	depends on NEXT3_FS_SNAPSHOT_JOURNAL
	default y
	help
	  Snapshot errors are recorded as journal errors.
	  Next3 should be mounted with errors=remount-ro.
	  After a snapshot error, the file system will be in read-only mode.
	  The administrator must un-mount the file system and run fsck
	  to prevent data corruption.
	  Some places in Ext3 original code don't check for return value of
	  JBD functions.  Check for snapshot/journal errors in those places.

config NEXT3_FS_SNAPSHOT_JOURNAL_CREDITS
	bool "Next3 snapshot journaled - increase transaction credits"
	depends on NEXT3_FS_SNAPSHOT_JOURNAL
	default y
	help
	  Snapshot operations are journaled as part of the running transaction.
	  The amount of requested credits is multiplied with a factor, to ensure
	  that enough buffer credits are reserved in the running transaction.

config NEXT3_FS_SNAPSHOT_JOURNAL_RELEASE
	bool "Next3 snapshot journaled - implement journal_release_buffer()"
	depends on NEXT3_FS_SNAPSHOT_JOURNAL
	default y
	help
	  journal_release_buffer() is called to cancel a previous call
	  to journal_get_write_access() and to recall the used buffer credit.
	  Current implementation of journal_release_buffer() in JBD is empty,
	  since no buffer credtis are used until the buffer is marked dirty.
	  However, because resulting snapshot COW operation cannot be undone,
	  we try to extend the current transaction to compensate for the used
	  credits of the extra COW operation, so we don't run out of buffer
	  credits too soon.

config NEXT3_FS_SNAPSHOT_JOURNAL_BYPASS
	bool "Next3 snapshot journaled - bypass to save credits"
	depends on NEXT3_FS_SNAPSHOT_JOURNAL
	default y
	help
	  Don't journal COW bitmap indirect blocks to save journal credits.

config NEXT3_FS_SNAPSHOT_JOURNAL_CACHE
	bool "Next3 snapshot journaled - cache last COW tid in journal_head"
	depends on NEXT3_FS_SNAPSHOT_JOURNAL
	default y
	help
	  Cache last COW transaction id in buffer's journal_head.
	  the cache supresses COW tests until the transaction in committed,
	  which implies an avarage cache expiry of 2.5 seconds.
	  Before taking a new snapshot, the journal is flushed to disk
	  and the current transaction in commited, so the COW cache is
	  invalidated (as it should be).

config NEXT3_FS_SNAPSHOT_JOURNAL_TRACE
	bool "Next3 snapshot journaled - trace COW/buffer credits"
	depends on NEXT3_FS_SNAPSHOT_JOURNAL
	depends on NEXT3_FS_DEBUG
	default y
	help
	  Extra debug prints to trace snapshot usage of buffer credits.

config NEXT3_FS_SNAPSHOT_LIST
	bool "Next3 snapshot list support"
	depends on NEXT3_FS_SNAPSHOT_FILE
	default y
	help
	  Implementation of multiple incremental snapshots.
	  Snapshot inodes are chained on a list starting at the super block,
	  both on-disk and in-memory, similar to the orhpan inodes.  We reuse
	  the orphan inode list functions to manipulate the snapshot list.
	  Unlink and truncate of snapshot inodes on the list is not allowed,
	  so an inode can never be chained on both orphan and snapshot lists.
	  We makes use of this fact to overload the in-memory inode field
	  next3_inode_info.i_orphan for the chaining of snapshots.

config NEXT3_FS_SNAPSHOT_LIST_PEEP
	bool "Next3 snapshot list - read through to previous snapshot"
	depends on NEXT3_FS_SNAPSHOT_LIST
	default y
	help
	  On snapshot page read, the function next3_get_block() is called
	  to map the page to a disk block.  If the page is not mapped in the
	  snapshot file, the previous snapshots on the list are checked.
	  The first found mapping is returned.

config NEXT3_FS_SNAPSHOT_RACE
	bool "Next3 snapshot race conditions"
	depends on NEXT3_FS_SNAPSHOT_BLOCK
	default y
	help
	  Resolve snapshot race conditions

config NEXT3_FS_SNAPSHOT_RACE_BITMAP
	bool "Next3 snapshot race conditions - concurrent COW bitmap operations"
	depends on NEXT3_FS_SNAPSHOT_RACE
	default y
	help
	  Wait for pending COW bitmap creations to complete.
	  When concurrent tasks try to COW buffers from the same block group
	  for the first time, the first task to reset the COW bitmap cache
	  is elected to create the new COW bitmap block.
	  The rest of the tasks wait until the COW bitmap cache is uptodate.
	  The COWing task copies the bitmap block into the new COW bitmap block
	  and updates the COW bitmap cache with the new block number.

config NEXT3_FS_SNAPSHOT_RACE_COW
	bool "Next3 snapshot race conditions - concurrent COW operations"
	depends on NEXT3_FS_SNAPSHOT_RACE
	default y
	help
	  Wait for pending COW operations to complete.
	  When concurrent tasks try to COW the same buffer, the task that takes
	  the active snapshot trucate_mutex is elected as the the COWing task.
	  The COWing task allocates a new snapshot block and creates a buffer
	  cache entry with ref_count=1 for that new block.  It then locks the
	  new buffer and marks it with the buffer_new flag.  The rest of the
	  tasks, find the 'new' buffer in the buffer cache and have to wait
	  until the buffer_new flag is cleared.  The COWing task copies the
	  source buffer into the 'new' buffer, unlocks it, marks it as journal
	  dirty data, clears the new_buffer flag and drops its reference count.
	  On active snapshot readpage, the buffer cache is checked.
	  If a 'new' buffer entry is found, the reader task waits until the
	  buffer_new flag is cleared and then copies the 'new' buffer directly
	  into the snapshot file page.

config NEXT3_FS_SNAPSHOT_RACE_READ
	bool "Next3 snapshot race conditions - tracked reads"
	depends on NEXT3_FS_SNAPSHOT_RACE
	select BLOCK_TRACKED_READ
	default y
	help
	  Wait for pending read I/O requests to complete.
	  When a snapshot file readpage reads through to the block device,
	  the snapshot page buffer is added to the block tracked readers.
	  Upon completion of the async read I/O request of the snapshot page,
	  the page buffer is removed from the block tracked readers.
	  When a block is being COWed, all of its tracked readers
	  have to remove themselves before the COW operation is completed.

config NEXT3_FS_SNAPSHOT_EXCLUDE
	bool "Next3 snapshot exclude"
	depends on NEXT3_FS_SNAPSHOT
	default y
	help
	  Mark all snapshot blocks excluded.
	  Excluding snapshot file blocks is essential for efficient cleanup
	  of deleted snapshot files.

config NEXT3_FS_SNAPSHOT_EXCLUDE_INODE
	bool "Next3 snapshot exclude - the exclude inode"
	depends on NEXT3_FS_SNAPSHOT_EXCLUDE
	default y
	help
	  The exclude inode owns all the exclude bitmap blocks.
	  The exclude inode is pre-allocated by 'tune2fs -O exclude_inode'.
	  The location of exclude bitmap blocks is read on mount time and cached
	  in the group descriptors.  The exclude inode is extended on online and
	  offline resize operations when block groups are added.

config NEXT3_FS_SNAPSHOT_EXCLUDE_BITMAP
	bool "Next3 snapshot exclude - the exclude bitmap"
	depends on NEXT3_FS_SNAPSHOT_EXCLUDE
	default y
	help
	  Excluding blocks is done by setting their bit in the exclude bitmap.
	  There is one exclude bitmap block per block group and it's location
	  is cached in the group descriptor.

config NEXT3_FS_SNAPSHOT_EXCLUDE_FILES
	bool "Next3 snapshot exclude - regular files (experimental)"
	depends on NEXT3_FS_SNAPSHOT_EXCLUDE
	default n
	help
	  Snapshot excluded files blocks are not COWed to snapshot.
	  Use 'chattr +d' to exclude a file or directory.
	  All snapshot files are implicitly excluded, even if you select N here.
	  This is an experimental feature.

config NEXT3_FS_SNAPSHOT_CLEANUP
	bool "Next3 snapshot cleanup"
	depends on NEXT3_FS_SNAPSHOT_LIST
	depends on NEXT3_FS_SNAPSHOT_EXCLUDE_BITMAP
	default y
	help
	  Cleanup snapshots list and reclaim unused blocks of deleted snapshots.
	  Oldest snapshot can be removed from list and it's blocks can be freed.
	  Non-oldest snapshots have to be shrunk and merged before they can be
	  removed from the list.  All snapshot blocks must be excluded in order
	  to properly shrink/merge deleted old snapshots.

config NEXT3_FS_SNAPSHOT_CLEANUP_SHRINK
	bool "Next3 snapshot cleanup - shrink deleted snapshots"
	depends on NEXT3_FS_SNAPSHOT_CLEANUP
	default y
	help
	  Free blocks of deleted snapshots, which are not in use by an older
	  non-deleted snapshot.  Shrinking helps reclaiming disk space
	  while older snapshots are currently in use (enabled).

config NEXT3_FS_SNAPSHOT_CLEANUP_MERGE
	bool "Next3 snapshot cleanup - merge shrunk snapshots"
	depends on NEXT3_FS_SNAPSHOT_CLEANUP_SHRINK
	default y
	help
	  Move blocks of deleted and shrunk snapshots to an older non-deleted
	  and disabled snapshot.  Merging helps removing snapshots from list
	  while older snapshots are not currently in use (disabled).
```
