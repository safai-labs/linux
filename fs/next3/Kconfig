## fs/overlayfs/Kconfig
```kconfig
config OVERLAY_FS
	tristate "Overlay filesystem support"
	select EXPORTFS
	help
	  An overlay filesystem combines two filesystems - an 'upper' filesystem
	  and a 'lower' filesystem.  When a name exists in both filesystems, the
	  object in the 'upper' filesystem is visible while the object in the
	  'lower' filesystem is either hidden or, in the case of directories,
	  merged with the 'upper' object.

	  For more information see Documentation/filesystems/overlayfs.txt

config OVERLAY_FS_REDIRECT_DIR
	bool "Overlayfs: turn on redirect dir feature by default"
	depends on OVERLAY_FS
	help
	  If this config option is enabled then overlay filesystems will use
	  redirects when renaming directories by default.  In this case it is
	  still possible to turn off redirects globally with the
	  "redirect_dir=off" module option or on a filesystem instance basis
	  with the "redirect_dir=off" mount option.

	  Note, that redirects are not backward compatible.  That is, mounting
	  an overlay which has redirects on a kernel that doesn't support this
	  feature will have unexpected results.

config OVERLAY_FS_INDEX
	bool "Overlayfs: turn on inodes index feature by default"
	depends on OVERLAY_FS
	help
	  If this config option is enabled then overlay filesystems will use
	  the inodes index dir to map lower inodes to upper inodes by default.
	  In this case it is still possible to turn off index globally with the
	  "index=off" module option or on a filesystem instance basis with the
	  "index=off" mount option.

	  The inodes index feature prevents breaking of lower hardlinks on copy
	  up and enables NFS export.

	  Note, that the inodes index feature is read-only backward compatible.
	  That is, mounting an overlay which has an index dir on a kernel that
	  doesn't support this feature read-only, will not have any negative
	  outcomes.  However, mounting the same overlay with an old kernel
	  read-write and then mounting it again with a new kernel, will have
	  unexpected results.

config OVERLAY_FS_CONSISTENT_FD
	bool "Overlayfs: turn on consistent fd feature by default"
	depends on OVERLAY_FS
	help
	  Overlayfs copies up a file when the file is opened for write.  Writes
          to the returned file descriptor are not visible to file descriptors
          that were opened for read prior to copy up.

          If this config option is enabled then overlay filesystems will default
          to copy up a file that is opened for read to avoid this inconsistency.
          In this case, it is still possible to turn off consistent fd globally
          with the "consistent_fd=off" module option or on a filesystem instance
          basis with the "consistent_fd=off" mount option.

          The feature will not be turned on for an overlay mount unless all
          the layers are on the same underlying filesystem and this filesystem
          supports clone.
```
